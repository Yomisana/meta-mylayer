## conf/layer.conf
```bitbake
BBPATH := "${BBPATH}:${LAYERDIR}"
BBFILES := "${BBFILES} ${LAYERDIR}/recipes-*/*.bb \
            ${BBFILES} ${LAYERDIR}/recipes-*/*/*.bbappend"

BBFILE_COLLECTIONS += "mylayer"
BBFILE_PATTERN_mylayer := "^${LAYERDIR}/"
BBFILE_PRIORITY_mylayer = "5"
LAYERSERIES_COMPAT_mylayer = "dunfell"
# LAYERSERIES_COMPAT_mylayer = "dunfell hardknott gatesgarth"
```
